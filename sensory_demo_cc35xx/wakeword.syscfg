/**
 * @cliArgs --board "/ti/boards/LP_EM_CC35X1" --rtos "freertos" --product "simplelink_wifi_sdk@9.21.00.15" --product "TOOLBOX@4.0.13"
 * @versions {"tool":"1.26.0+4407"}
 */

/**
 * Import the modules used in this configuration.
 */
const FreeRTOS              = scripting.addModule("/freertos/FreeRTOS");
const CryptoKeyKeyStore_PSA = scripting.addModule("/ti/drivers/CryptoKeyKeyStore_PSA");
const GPIO                  = scripting.addModule("/ti/drivers/GPIO");
const I2S                   = scripting.addModule("/ti/drivers/I2S", {}, false);
const I2S1                  = I2S.addInstance();
const Power                 = scripting.addModule("/ti/drivers/Power");
const UART2                 = scripting.addModule("/ti/drivers/UART2");
const UART21                = UART2.addInstance();
const UART22                = UART2.addInstance();
const LED                   = scripting.addModule("/ti/drivers/apps/LED", {}, false);
const LED1                  = LED.addInstance();
const LED2                  = LED.addInstance();
const LED3                  = LED.addInstance();
const Mem_cfg               = scripting.addModule("/ti/memoryconfig/MemoryConfigurator/Mem_cfg");
const Settings              = scripting.addModule("/ti/posix/freertos/Settings");

/**
 * Write custom configuration values to the imported modules.
 */
FreeRTOS.useTimeSlicing = true;
FreeRTOS.heapSize       = 0x00051000;

I2S1.$name = "CONFIG_I2S_0";

UART21.$name                     = "CONFIG_UART2_0";
UART21.$hardware                 = system.deviceData.board.components.XDS110UART;
UART21.uart.dmaTxChannel.$assign = "DMA_CH2";
UART21.uart.dmaRxChannel.$assign = "DMA_CH3";

UART22.$name = "CONFIG_UART2_1";

LED1.$name     = "RED_LED";
LED1.$hardware = system.deviceData.board.components.LED_RED;

LED2.$hardware = system.deviceData.board.components.LED_GREEN;
LED2.$name     = "GREEN_LED";

LED3.$hardware = system.deviceData.board.components.LED_BLUE;
LED3.$name     = "BLUE_LED";

/**
 * Pinmux solution for unlocked pins/peripherals. This ensures that minor changes to the automatic solver in a future
 * version of the tool will not impact the pinmux you originally saw.  These lines can be completely deleted in order to
 * re-solve from scratch.
 */
I2S1.i2s.$suggestSolution                 = "I2S0";
I2S1.i2s.SD0Pin.$suggestSolution          = "boosterpack.26";
I2S1.i2s.SD1Pin.$suggestSolution          = "boosterpack.25";
I2S1.i2s.SCKPin.$suggestSolution          = "boosterpack.38";
I2S1.i2s.WSPin.$suggestSolution           = "boosterpack.37";
UART21.uart.$suggestSolution              = "UART1";
UART21.uart.txPin.$suggestSolution        = "GPIO5";
UART21.uart.rxPin.$suggestSolution        = "GPIO6";
UART22.uart.$suggestSolution              = "UART0";
UART22.uart.dmaTxChannel.$suggestSolution = "DMA_CH1";
UART22.uart.dmaRxChannel.$suggestSolution = "DMA_CH0";
UART22.uart.txPin.$suggestSolution        = "boosterpack.4";
UART22.uart.rxPin.$suggestSolution        = "boosterpack.3";
LED1.ledPin.$suggestSolution              = "boosterpack.31";
LED2.ledPin.$suggestSolution              = "boosterpack.17";
LED3.ledPin.$suggestSolution              = "boosterpack.36";
